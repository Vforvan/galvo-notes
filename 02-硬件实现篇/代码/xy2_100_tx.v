//============================================================================
// xy2_100_tx.v -- XY2-100 振镜协议发送器 (FPGA / Verilog-2001)
//----------------------------------------------------------------------------
// 功能: 把 X/Y 两轴的目标位置按 XY2-100 协议串行发送出去
//
// 时钟方案:
//   输入 clk = 12 MHz
//   一个 bit 周期 500 ns 分成 6 个相位, 每相位 1 个 12 MHz 周期 (83.33 ns)
//
//     相位 0 : CLK 上升沿   <-- 输出数据在此沿更新
//     相位 1 : CLK 高
//     相位 2 : CLK 高
//     相位 3 : CLK 下降沿   <-- 接收方在此沿采样
//     相位 4 : CLK 低
//     相位 5 : CLK 低
//
//   => CLK 半周期 = 3 相位 = 250 ns  => 输出 CLK = 2 MHz   [OK]
//   => 帧长 = 20 bit * 500 ns = 10 us, 帧率 100 kHz        [OK]
//   => 数据在采样沿前 250 ns 已稳定 (规范 tDS >= 50 ns)     [OK]
//   => 数据在采样沿后保持 250 ns (规范 tDH >= 100 ns)       [OK]
//
// 位索引约定 (核心):
//   bit_idx 直接表示"当前线上正在发送 word 的第几位":
//     bit_idx = 19 -> word[19]  (控制字 C2, 第 1 个发出的位)
//     bit_idx = 0  -> word[0]   (偶校验位, 第 20 个发出的位)
//   发送位置 position = 20 - bit_idx, 取值 20..1
//   当 bit_idx == 0 时这一位即为帧的最后一位, 位边界处提交下一帧
//
//   ⚠️ 这样设计是为了避免"计数器值"与"线上位序"错开一位的经典陷阱:
//      若位边界时输出 shifter[20-cnt] 同时又 cnt+1, 会重复发送同一位
//      并丢掉一位 (实测会丢掉校验位)。直接用 idx 递减最直观且不会错。
//
// 帧格式 (标准 16 位模式), 发送顺序 = bit19 -> bit0:
//   bit[19:17] = 3'b001      控制字
//   bit[16:1]  = D15..D0     位置数据, MSB first
//   bit[0]     = 偶校验位
//
// ⚠️ 校验范围 (重要):
//   偶校验覆盖**全部 19 个前导位**(控制字 + 位置数据), 不是只覆盖 16 个数据位。
//   即 P = XOR(C2,C1,C0,D15..D0), 使整帧 20 bit 中 1 的个数为偶数。
//   因为控制字 001 本身含 1 个 '1', 只对数据位求校验会得到相反的结果。
//
// 符合规范的要点:
//   - CLK 连续运行, 永不停顿
//   - SYNC 上升沿 = 帧开始; 第 20 bit(校验位)期间为低 => 高电平持续 19 bit
//   - 帧与帧之间无间隙
//   - 位置不变时自动重复发送上一帧
//
// 许可: 本文件由 DSH 生成, 可自由使用/修改
//============================================================================

`default_nettype none

module xy2_100_tx #(
    parameter CLK_HZ = 12_000_000        // 输入时钟频率, 应为 2MHz * 6
) (
    input  wire        clk,              // 12 MHz 主时钟
    input  wire        rst_n,            // 异步复位, 低有效

    // ---- 目标位置 (有符号) ----
    input  wire signed [15:0] x_target,  // -32768 .. +32767 ; 0 = 中心
    input  wire signed [15:0] y_target,  // -32768 .. +32767 ; 0 = 中心
    input  wire               load,      // 单周期脉冲: 装载新目标值
                                         // (不装载时自动重复发送上一帧)

    // ---- XY2-100 差分输出 (P = 正端, N = 负端) ----
    output reg         clk_p,
    output wire        clk_n,            // = ~clk_p
    output reg         sync_p,
    output wire        sync_n,           // = ~sync_p
    output reg         x_p,
    output wire        x_n,              // = ~x_p
    output reg         y_p,
    output wire        y_n               // = ~y_p
);

    //------------------------------------------------------------------------
    // 差分负端: 逻辑取反 (真正的差分驱动由外部 RS-422 芯片完成)
    //------------------------------------------------------------------------
    assign clk_n  = ~clk_p;
    assign sync_n = ~sync_p;
    assign x_n    = ~x_p;
    assign y_n    = ~y_p;

    //------------------------------------------------------------------------
    // 复位默认帧 = X/Y 都指向中心 (0, 0)
    //   0 -> 偏移二进制 0x8000 -> 数据占 bit[16:1] -> 0x10000
    //   加控制字 001 -> 0x30000 ; 19 位中 2 个 '1' (偶) -> 校验位 0
    //   => 0x30000
    //------------------------------------------------------------------------
    localparam [19:0] RESET_WORD = 20'h30000;

    //------------------------------------------------------------------------
    // 相位计数器: 0..5 循环
    //------------------------------------------------------------------------
    reg [2:0] phase;
    wire      phase_last = (phase == 3'd5);

    always @(posedge clk or negedge rst_n) begin
        if (!rst_n)          phase <= 3'd0;
        else if (phase_last) phase <= 3'd0;
        else                 phase <= phase + 3'd1;
    end

    //------------------------------------------------------------------------
    // 位索引: 19 递减到 0
    //------------------------------------------------------------------------
    reg [4:0]  bit_idx;
    wire       last_bit = (bit_idx == 5'd0);     // 校验位所在位
    wire       bit_end  = phase_last;            // 位边界

    //------------------------------------------------------------------------
    // 目标位置 -> 20 bit 发送字 (组合逻辑)
    //------------------------------------------------------------------------
    wire [15:0] x_wire = {~x_target[15], x_target[14:0]};   // = target + 32768
    wire [15:0] y_wire = {~y_target[15], y_target[14:0]};

    // 数据占 bit[16:1]: wire[15] -> 帧 bit16, wire[0] -> 帧 bit1
    wire [19:0] frame_x = {3'b001, x_wire, 1'b0};
    wire [19:0] frame_y = {3'b001, y_wire, 1'b0};

    // 偶校验: P = XOR(bit[19:1])  (使整帧 20 bit 的 XOR 为 0)
    wire par_x = ^frame_x[19:1];
    wire par_y = ^frame_y[19:1];

    wire [19:0] tx_word_x = {frame_x[19:1], par_x};
    wire [19:0] tx_word_y = {frame_y[19:1], par_y};

    //------------------------------------------------------------------------
    // 当前帧寄存器
    //------------------------------------------------------------------------
    reg [19:0] shifter_x;
    reg [19:0] shifter_y;

    // 下一拍要发送的位
    wire nbit_x = shifter_x[bit_idx];
    wire nbit_y = shifter_y[bit_idx];

    //------------------------------------------------------------------------
    // 装载暂存 (重要设计考虑)
    //   load 是单周期脉冲, 可能出现在帧周期任意时刻, 而新帧只能在帧结束时
    //   整帧生效。因此必须把请求暂存 (pending), 否则若在帧边界前撤销 load,
    //   这次请求就被丢掉了。
    //------------------------------------------------------------------------
    reg        pend_x, pend_y;
    reg [19:0] pend_word_x, pend_word_y;

    // 帧边界提交时的实际取值
    wire [19:0] latch_x = pend_x ? pend_word_x : shifter_x;
    wire [19:0] latch_y = pend_y ? pend_word_y : shifter_y;

    //------------------------------------------------------------------------
    // 输出逻辑 (全部寄存器输出, 保证无毛刺)
    //------------------------------------------------------------------------
    always @(posedge clk or negedge rst_n) begin
        if (!rst_n) begin
            // 复位时 CLK 保持低电平, 且数据已预先摆好第 1 个位 (bit19)。
            // 这样复位释放后经过 3 个相位才出现第一个下降沿, 接收方在
            // 该下降沿采到的正是第 1 个位 —— 采样窗口与帧边界精确对齐。
            // (若复位时 CLK 置高, 首帧会整体错位一个 bit)
            clk_p       <= 1'b0;
            sync_p      <= 1'b1;                // bit_idx=19 => 非末位 => 高
            x_p         <= RESET_WORD[19];      // 预先输出第 1 个位
            y_p         <= RESET_WORD[19];
            bit_idx     <= 5'd19;
            shifter_x   <= RESET_WORD;
            shifter_y   <= RESET_WORD;
            pend_x      <= 1'b0;
            pend_y      <= 1'b0;
            pend_word_x <= RESET_WORD;
            pend_word_y <= RESET_WORD;
        end else begin
            // ---- 输出时钟: 相位 0,1,2 高; 相位 3,4,5 低 ----
            clk_p  <= ~phase_last;

            // ---- 同步: 仅最后一位 (校验位, bit_idx=0) 期间为低 ----
            //      高电平覆盖前 19 位
            sync_p <= ~last_bit;

            // ---- 暂存外部装载请求 ----
            if (load) begin
                pend_x      <= 1'b1;
                pend_y      <= 1'b1;
                pend_word_x <= tx_word_x;
                pend_word_y <= tx_word_y;
            end

            // ---- 位边界 (相位 5 -> 下一拍进入相位 0 上升沿) ----
            //      顺序至关重要: 先输出"当前位", 再推进位索引/提交新帧。
            //      这样线上序列恰好是 word[19]..word[0] 循环, 接收方在
            //      下降沿采到的 20 位窗口正好等于一个完整的帧。
            if (bit_end) begin
                // (1) 先输出当前位 (bit_idx 指向的那一位)
                x_p <= shifter_x[bit_idx];
                y_p <= shifter_y[bit_idx];

                // (2) 再推进索引 / 提交下一帧
                if (last_bit) begin
                    // 最后一位已发完: 提交新帧, 下一位从 bit19 重新开始
                    shifter_x <= latch_x;
                    shifter_y <= latch_y;
                    pend_x    <= 1'b0;
                    pend_y    <= 1'b0;
                    bit_idx   <= 5'd19;
                end else begin
                    bit_idx <= bit_idx - 5'd1;
                end
            end
            // 其余相位: 输出保持不变 => 数据在采样沿稳定
        end
    end

endmodule

`default_nettype wire
